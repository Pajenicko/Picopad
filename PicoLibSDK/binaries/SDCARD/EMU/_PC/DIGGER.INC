
	char	char_0[] = {	 3 , 12 ,
			 63,255,192,
			255,255,240,
			240,  0,240,
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			 63,255,192,0	};

	char	char_1[] = {	 3 , 12 ,
			  0, 60,  0,
			  0, 60,  0,
			  0, 60,  0,
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			  0,252,  0,0	};

	char	char_2[] = {	 3 , 12 ,
			 63,255,192,
			255,255,240,
			240,  0,240,
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			 63,255,240,0	};

	char	char_3[] = {	 3 , 12 ,
			 63,252,  0,
			255,255,  0,
			240, 15,  0,
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			 63,255,192,0	};

	char	char_4[] = {	 3 , 12 ,
			240,  0,  0,
			240,  0,  0,
			240, 15,  0,
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			  0, 63,  0,0	};

	char	char_5[] = {	 3 , 12 ,
			 63,255,  0,
			255,255,  0,
			240,  0,  0,
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			 63,255,192,0	};

	char	char_6[] = {	 3 , 12 ,
			 63,255,192,
			255,255,240,
			240,  0,240,
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			 63,255,192,0	};

	char	char_7[] = {	 3 , 12 ,
			 63,255,192,
			 63,255,240,
			  0,  0,240,
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			  0,  3,240,0	};

	char	char_8[] = {	 3 , 12 ,
			  3,255,  0,
			 15,255,192,
			 15,  3,192,
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			 63,255,192,0	};

	char	char_9[] = {	 3 , 12 ,
			 63,255,192,
			255,255,240,
			240,  0,240,
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			  0, 15,240,0	};

	char	char_a[] = {	 3 , 12 ,
			 15,255,  0,
			 63,255,192,
			 60,  3,192,
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			252,  0,240,0	};

	char	char_b[] = {	 3 , 12 ,
			 63,252,  0,
			255,255,  0,
			240, 15,  0,
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			 63,255,192,0	};

	char	char_c[] = {	 3 , 12 ,
			 63,255,192,
			255,255,240,
			240,  0,240,
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			 63,255,192,0	};

	char	char_d[] = {	 3 , 12 ,
			255,255,192,
			255,255,240,
			240,  0,240,
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			255,255,192,0	};

	char	char_e[] = {	 3 , 12 ,
			 63,255,240,
			255,255,240,
			240,  0,  0,
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			 63,255,240,0	};

	char	char_f[] = {	 3 , 12 ,
			 63,255,240,
			255,255,240,
			252,  0,  0,
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			255,  0,  0,0	};

	char	char_g[] = {	 3 , 12 ,
			 63,255,192,
			255,255,240,
			240,  0,240,
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			 63,255,192,0	};

	char	char_h[] = {	 3 , 12 ,
			240,  0,240,
			240,  0,240,
			240,  0,240,
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			255,  0,240,0	};

	char	char_i[] = {	 3 , 12 ,
			  0,240,  0,
			  0,240,  0,
			  0,240,  0,
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			  0,255,  0,0	};

	char	char_j[] = {	 3 , 12 ,
			  0, 15,  0,
			  0, 15,  0,
			  0, 15,  0,
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			 63,255,192,0	};

	char	char_k[] = {	 3 , 12 ,
			240, 15,  0,
			240, 15,  0,
			240, 15,  0,
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			255,  0,240,0	};

	char	char_l[] = {	 3 , 12 ,
			240,  0,  0,
			240,  0,  0,
			240,  0,  0,
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			 63,255,240,0	};

	char	char_m[] = {	 3 , 12 ,
			 63,255,192,
			255,255,240,
			240,240,240,
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			252,240,240,0	};

	char	char_n[] = {	 3 , 12 ,
			 15,255,192,
			 63,255,240,
			 60,  0,240,
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			 63,  0,240,0	};

	char	char_o[] = {	 3 , 12 ,
			 63,255,192,
			255,255,240,
			240, 15,240,
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			 63,255,192,0	};

	char	char_p[] = {	 3 , 12 ,
			 63,255,192,
			255,255,240,
			240,  0,240,
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			255,  0,  0,0	};

	char	char_pe[] = {	 3 , 12 ,
			  0,  0,  0,
			  0,  0,  0,
			  0,  0,  0,
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			  3,192,  0,0	};

	char	char_q[] = {	 3 , 12 ,
			 63,255,192,
			255,255,240,
			240,  0,240,
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			 63,255,192,0	};

	char	char_r[] = {	 3 , 12 ,
			 63,252,  0,
			255,255,  0,
			240, 15,  0,
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			240,  0,240,0	};

	char	char_s[] = {	 3 , 12 ,
			 63,255,192,
			255,255,240,
			240,  0,240,
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			 63,255,192,0	};

	char	char_sp[] = {	 3 , 12 ,
			  0,  0,  0,
			  0,  0,  0,
			  0,  0,  0,
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			  0,  0,  0,0	};

	char	char_t[] = {	 3 , 12 ,
			255,255,240,
			255,255,240,
			  0,240,  0,
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			  0,255,  0,0	};

	char	char_u[] = {	 3 , 12 ,
			240,  0,240,
			240,  0,240,
			240,  0,240,
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			 63,255,192,0	};

	char	char_ul[] = {	 3 , 12 ,
			  0,  0,  0,
			  0,  0,  0,
			  0,  0,  0,
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			 15,255,240,0	};

	char	char_v[] = {	 3 , 12 ,
			240,  0,240,
			240,  0,240,
			240,  0,240,
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			 15,252,  0,0	};

	char	char_w[] = {	 3 , 12 ,
			240,240,240,
			240,240,240,
			240,240,240,
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			 63,255,192,0	};

	char	char_x[] = {	 3 , 12 ,
			240,  0,240,
			240,  0,240,
			240,  0,240,
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			255,  0,240,0	};

	char	char_y[] = {	 3 , 12 ,
			240,  0,240,
			240,  0,240,
			240,  0,240,
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			  0,252,  0,0	};

	char	char_z[] = {	 3 , 12 ,
			 63,255,192,
			255,255,240,
			240,  0,240,
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			 63,255,192,0	};

