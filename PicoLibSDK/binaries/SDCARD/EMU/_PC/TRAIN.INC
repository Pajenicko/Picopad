
; This file was created by screen capture with GDemo program (to *.SCR file)
; and then exported to ASM format with BinS (and then edited).

Titulek label byte           ; titulni obrazek

TitulekObr label byte
	db	000h, 000h, 000h, 000h, 000h, 000h, 000h, 000h, 000h, 000h, 000h, 000h, 0c6h, 000h, 000h, 000h
	db	000h, 000h, 000h, 000h, 000h, 000h, 000h, 000h, 000h, 000h, 000h, 000h, 000h, 000h, 000h, 000h
	db	000h, 000h, 000h, 000h, 000h, 000h, 000h, 000h, 000h, 000h, 000h, 000h, 0c6h, 000h, 000h, 000h
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	db	04bh, 0aah, 0e7h, 075h, 002h, 0eeh, 0e0h, 000h, 000h, 000h, 000h, 000h, 000h, 000h, 000h, 000h

Obrazky  label     byte                     ; obrazky

NicObr	label byte
	db	000h, 000h, 000h, 000h, 000h, 000h, 000h, 000h, 000h, 000h, 000h, 000h, 000h, 000h, 000h, 000h
	db	000h, 000h, 000h, 000h, 000h, 000h, 000h, 000h, 000h, 000h, 000h, 000h, 000h, 000h, 000h, 000h
	db	000h, 000h, 000h, 000h, 000h, 000h, 000h, 000h, 000h, 000h, 000h, 000h, 000h, 000h, 000h, 000h
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	db	000h, 000h, 000h, 000h, 000h, 000h, 000h, 000h, 000h, 000h, 000h, 000h, 000h, 000h, 000h, 000h

RuzneObr label byte
	db	000h, 000h, 004h, 000h, 008h, 07eh, 00ch, 042h, 01eh, 042h, 01eh, 042h, 03fh, 0feh, 07fh, 0feh
	db	07fh, 0feh, 07fh, 0feh, 07fh, 0feh, 03fh, 0ffh, 000h, 000h, 000h, 000h, 000h, 000h, 000h, 000h
	db	000h, 000h, 004h, 000h, 008h, 000h, 000h, 000h, 000h, 000h, 000h, 000h, 000h, 000h, 000h, 000h
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	db	0a0h, 005h, 0a0h, 005h, 0a0h, 005h, 0a0h, 005h, 0a0h, 005h, 0a0h, 005h, 0a0h, 005h, 0e0h, 007h

VagonyObr label byte
	db	000h, 000h, 000h, 000h, 001h, 0fch, 003h, 0fch, 007h, 0fch, 00fh, 0fch, 00fh, 0f8h, 000h, 000h
	db	000h, 000h, 000h, 000h, 000h, 000h, 0c0h, 001h, 00ch, 018h, 01eh, 03ch, 01eh, 03ch, 00ch, 018h
	db	000h, 000h, 000h, 000h, 001h, 0f8h, 003h, 0c0h, 007h, 080h, 00fh, 0c0h, 00fh, 080h, 03fh, 0feh
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	db	006h, 0d0h, 002h, 0d0h, 003h, 0d0h, 003h, 0d0h, 003h, 090h, 003h, 090h, 007h, 010h, 00fh, 000h

VeciObr label byte
	db	000h, 000h, 000h, 000h, 000h, 000h, 001h, 080h, 003h, 0c0h, 007h, 0e0h, 00fh, 0f0h, 01fh, 0f8h
	db	01fh, 0f8h, 01fh, 0f8h, 01fh, 0f8h, 00fh, 0f0h, 007h, 0e0h, 003h, 0c0h, 001h, 080h, 000h, 000h
	db	000h, 000h, 000h, 000h, 000h, 000h, 001h, 000h, 003h, 000h, 007h, 000h, 00fh, 000h, 01fh, 0f8h
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	db	07fh, 0ffh, 067h, 0e0h, 067h, 0c0h, 0c7h, 080h, 00fh, 000h, 01eh, 000h, 000h, 000h, 000h, 000h
